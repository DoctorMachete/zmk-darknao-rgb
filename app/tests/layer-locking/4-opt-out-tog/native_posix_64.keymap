#include "../behavior_keymap.dtsi"

&kscan {
    events = <
        /* &tog_nl (no `locking;`): on, not locked */
        ZMK_MOCK_PRESS(2,1,10)
        ZMK_MOCK_RELEASE(2,1,10)
        ZMK_MOCK_PRESS(0,0,10)
        ZMK_MOCK_RELEASE(0,0,10)
        /* &tog_nl again: off, as before the port */
        ZMK_MOCK_PRESS(2,1,10)
        ZMK_MOCK_RELEASE(2,1,10)
        ZMK_MOCK_PRESS(0,0,10)
        ZMK_MOCK_RELEASE(0,0,10)
        /* on again with &tog_nl, then &mo 1 press + release turns it off (not locked) */
        ZMK_MOCK_PRESS(2,1,10)
        ZMK_MOCK_RELEASE(2,1,10)
        ZMK_MOCK_PRESS(0,1,10)
        ZMK_MOCK_RELEASE(0,1,10)
        ZMK_MOCK_PRESS(0,0,10)
        ZMK_MOCK_RELEASE(0,0,10)
        /* on with &tog_nl, lock with the stock &tog 1 inside layer 1 */
        ZMK_MOCK_PRESS(2,1,10)
        ZMK_MOCK_RELEASE(2,1,10)
        ZMK_MOCK_PRESS(1,0,10)
        ZMK_MOCK_RELEASE(1,0,10)
        /* &tog_nl cannot turn off a locked layer */
        ZMK_MOCK_PRESS(2,1,10)
        ZMK_MOCK_RELEASE(2,1,10)
        ZMK_MOCK_PRESS(0,0,10)
        ZMK_MOCK_RELEASE(0,0,10)
        /* the stock &tog 1 does */
        ZMK_MOCK_PRESS(1,0,10)
        ZMK_MOCK_RELEASE(1,0,10)
        ZMK_MOCK_PRESS(0,0,10)
        ZMK_MOCK_RELEASE(0,0,10)
    >;
};
