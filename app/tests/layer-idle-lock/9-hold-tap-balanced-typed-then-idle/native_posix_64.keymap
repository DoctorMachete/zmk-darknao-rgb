#include "../hold_tap_keymap.dtsi"

&kscan {
    events = <
        /* thumb down, N1 tapped inside the tapping term: balanced -> hold at N1 release */
        ZMK_MOCK_PRESS(0,1,50)
        ZMK_MOCK_PRESS(0,0,10)
        /* then 700 ms idle with the thumb held: locks 500 ms after the hold decision */
        ZMK_MOCK_RELEASE(0,0,700)
        ZMK_MOCK_RELEASE(0,1,10)
        ZMK_MOCK_PRESS(1,0,10)
        ZMK_MOCK_RELEASE(1,0,10)
        ZMK_MOCK_PRESS(0,1,10)
        ZMK_MOCK_RELEASE(0,1,10)
        ZMK_MOCK_PRESS(1,0,10)
        ZMK_MOCK_RELEASE(1,0,10)
    >;
};
