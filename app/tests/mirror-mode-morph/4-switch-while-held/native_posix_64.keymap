#include "../behavior_keymap.dtsi"

&kscan {
    events = <
        /* a on; hold 2 (F); b on while held; release 2: F released. Then &mir_a MO held,
           press 0 (B), release MO (off), release 0: B released */
        ZMK_MOCK_PRESS(1,0,10)
        ZMK_MOCK_RELEASE(1,0,10)
        ZMK_MOCK_PRESS(0,2,10)
        ZMK_MOCK_PRESS(1,1,10)
        ZMK_MOCK_RELEASE(1,1,10)
        ZMK_MOCK_RELEASE(0,2,10)
        ZMK_MOCK_PRESS(1,1,10)
        ZMK_MOCK_RELEASE(1,1,10)
        ZMK_MOCK_PRESS(2,0,10)
        ZMK_MOCK_PRESS(0,0,10)
        ZMK_MOCK_RELEASE(2,0,10)
        ZMK_MOCK_RELEASE(0,0,10)
    >;
};
