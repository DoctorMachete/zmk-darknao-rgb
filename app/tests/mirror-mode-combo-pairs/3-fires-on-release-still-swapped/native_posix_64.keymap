#include "../behavior_keymap.dtsi"

&kscan {
    events = <
        /* on: 3+2 act as 0+1 while {0,1,2} is still pending; releasing 3 fires the combo, the
           mirror already saw that release: still swapped, ] */
        ZMK_MOCK_PRESS(2,0,10)
        ZMK_MOCK_RELEASE(2,0,10)
        ZMK_MOCK_PRESS(0,3,10)
        ZMK_MOCK_PRESS(0,2,10)
        ZMK_MOCK_RELEASE(0,3,10)
        ZMK_MOCK_RELEASE(0,2,10)
        ZMK_MOCK_PRESS(2,0,10)
        ZMK_MOCK_RELEASE(2,0,10)
    >;
};
