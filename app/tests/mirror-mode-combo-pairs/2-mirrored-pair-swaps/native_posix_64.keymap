#include "../behavior_keymap.dtsi"

&kscan {
    events = <
        /* on: 3+2 act as 0+1, the opener, swapped: ]; 2+1 act as 1+2: [ */
        ZMK_MOCK_PRESS(2,0,10)
        ZMK_MOCK_RELEASE(2,0,10)
        ZMK_MOCK_PRESS(0,3,10)
        ZMK_MOCK_PRESS(0,2,100)
        ZMK_MOCK_RELEASE(0,3,10)
        ZMK_MOCK_RELEASE(0,2,10)
        ZMK_MOCK_PRESS(0,2,10)
        ZMK_MOCK_PRESS(0,1,100)
        ZMK_MOCK_RELEASE(0,2,10)
        ZMK_MOCK_RELEASE(0,1,10)
        ZMK_MOCK_PRESS(2,0,10)
        ZMK_MOCK_RELEASE(2,0,10)
    >;
};
