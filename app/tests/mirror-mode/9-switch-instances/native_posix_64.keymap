#include "../behavior_keymap.dtsi"

&kscan {
    events = <
        /* mirror_a on (F13); mirror_b on: F14 then F15; 1 -> 3 (b's map): D; b off: F16 */
        ZMK_MOCK_PRESS(2,0,10)
        ZMK_MOCK_RELEASE(2,0,10)
        ZMK_MOCK_PRESS(2,3,10)
        ZMK_MOCK_RELEASE(2,3,10)
        ZMK_MOCK_PRESS(0,1,10)
        ZMK_MOCK_RELEASE(0,1,10)
        ZMK_MOCK_PRESS(2,3,10)
        ZMK_MOCK_RELEASE(2,3,10)
        /* nothing on: B */
        ZMK_MOCK_PRESS(0,1,10)
        ZMK_MOCK_RELEASE(0,1,10)
    >;
};
