#include "../behavior_keymap.dtsi"

&kscan {
    events = <
        /* on: physical 6+7 act as 5+4 for combos: Z. Physical 4+5 act as 7+6: no combo, keys
           mirrored: H, G */
        ZMK_MOCK_PRESS(2,0,10)
        ZMK_MOCK_RELEASE(2,0,10)
        ZMK_MOCK_PRESS(1,2,10)
        ZMK_MOCK_PRESS(1,3,100)
        ZMK_MOCK_RELEASE(1,2,10)
        ZMK_MOCK_RELEASE(1,3,10)
        ZMK_MOCK_PRESS(1,0,10)
        ZMK_MOCK_PRESS(1,1,100)
        ZMK_MOCK_RELEASE(1,0,10)
        ZMK_MOCK_RELEASE(1,1,10)
    >;
};
