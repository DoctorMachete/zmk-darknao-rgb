#include "../behavior_keymap.dtsi"

&kscan {
    events = <
        /* &kt_iflayer D 9: the keymap has 2 layers, warning, nothing sent */
        ZMK_MOCK_PRESS(2,0,10)
        ZMK_MOCK_RELEASE(2,0,10)
    >;
};
