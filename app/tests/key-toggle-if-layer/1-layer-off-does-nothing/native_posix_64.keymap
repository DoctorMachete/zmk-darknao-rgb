#include "../behavior_keymap.dtsi"

&kscan {
    events = <
        /* layer 1 off: tapping &kt_iflayer B 1 sends nothing */
        ZMK_MOCK_PRESS(0,0,10)
        ZMK_MOCK_RELEASE(0,0,10)
        ZMK_MOCK_PRESS(0,0,10)
        ZMK_MOCK_RELEASE(0,0,10)
    >;
};
