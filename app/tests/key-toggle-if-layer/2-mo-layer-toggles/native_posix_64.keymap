#include "../behavior_keymap.dtsi"

&kscan {
    events = <
        /* hold &mo 1 */
        ZMK_MOCK_PRESS(0,1,10)
        /* tap: B on */
        ZMK_MOCK_PRESS(0,0,10)
        ZMK_MOCK_RELEASE(0,0,10)
        /* tap: B off */
        ZMK_MOCK_PRESS(0,0,10)
        ZMK_MOCK_RELEASE(0,0,10)
        ZMK_MOCK_RELEASE(0,1,10)
    >;
};
