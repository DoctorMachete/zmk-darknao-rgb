#include "../behavior_keymap.dtsi"

&kscan {
    events = <
        /* CONFIG_ZMK_MIRROR_MODE_COMBOS=n: hold-tap sees physical keys. on; physical 4 acts as 7, the
           mod-tap; physical 5 (as 6, G) decides it: Shift+G */
        ZMK_MOCK_PRESS(2,0,10)
        ZMK_MOCK_RELEASE(2,0,10)
        ZMK_MOCK_PRESS(1,0,10)
        ZMK_MOCK_PRESS(1,1,10)
        ZMK_MOCK_RELEASE(1,1,10)
        ZMK_MOCK_RELEASE(1,0,10)
    >;
};
