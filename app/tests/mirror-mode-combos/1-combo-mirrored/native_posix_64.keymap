#include "../behavior_keymap.dtsi"

&kscan {
    events = <
        /* off: physical 2+3 is combo {2,3}: X */
        ZMK_MOCK_PRESS(0,2,10)
        ZMK_MOCK_PRESS(0,3,100)
        ZMK_MOCK_RELEASE(0,2,10)
        ZMK_MOCK_RELEASE(0,3,10)
        /* on: physical 0+1 act as 3+2: the same combo, X */
        ZMK_MOCK_PRESS(2,0,10)
        ZMK_MOCK_RELEASE(2,0,10)
        ZMK_MOCK_PRESS(0,0,10)
        ZMK_MOCK_PRESS(0,1,100)
        ZMK_MOCK_RELEASE(0,0,10)
        ZMK_MOCK_RELEASE(0,1,10)
    >;
};
