## app/dts/bindings/behaviors/zmk,behavior-battery-indicator.yaml
```yaml
# Copyright (c) 2024, The ZMK Contributors
# SPDX-License-Identifier: MIT

description: |
  Persistent, relocatable battery-level indicator block. The `positions`
  property lists the physical strip pixels (local half) that form the charge
  ramp. Invoke with param1 = 1 to show, param1 = 0 to hide.

compatible: "zmk,behavior-battery-indicator"

include: one_param.yaml

properties:
  positions:
    type: array
    required: true
    description: |
      Physical strip pixel indices (local half) that make up the battery block,
      ordered from empty to full. Up to 8 entries.
```

## app/dts/bindings/behaviors/zmk,behavior-caps-word.yaml
```yaml
# Copyright (c) 2021 The ZMK Contributors
# SPDX-License-Identifier: MIT

description: Caps word behavior

compatible: "zmk,behavior-caps-word"

include: zero_param.yaml

properties:
  continue-list:
    type: array
    required: true
  mods:
    type: int
  enter:
    type: phandle-array
    specifier-space: binding
    description: |
      One or more behaviors triggered, in order, when caps word activates. Optional.
      Side-effect-only outputs (RGB, backlight, display, buzzer) -- do NOT bind key output
      here: the resulting keycode feeds back into the word-break check and switches caps
      word straight off again.
  exit:
    type: phandle-array
    specifier-space: binding
    description: |
      One or more behaviors triggered, in order, when caps word deactivates -- whether by
      toggling it off or by a word-breaking key. Optional. Fires during the breaking
      keypress, before that key reaches the host.
  not-press-release-outputs:
    type: boolean
    description: |
      Fire enter/exit as immediate, side-effect-only outputs instead of emulated key presses.
      When set, each binding's press handler is invoked directly and synchronously (no
      behavior queue, no tap-ms/wait-ms delay) and no release is sent. Same name, meaning and
      default as the equivalent property in the zmk-listeners module. Do NOT set it for
      bindings that need real press/release semantics.
  tap-ms:
    type: int
    default: 5
    description: |
      Time to wait (in milliseconds) between the press and release of each enter/exit
      binding on the default queued path. Ignored when not-press-release-outputs is set.
  wait-ms:
    type: int
    default: 5
    description: |
      Time to wait (in milliseconds) before the next binding in an enter/exit chain on the
      default queued path. Ignored when not-press-release-outputs is set.
```

## app/dts/bindings/behaviors/zmk,behavior-key-toggle-if-layer.yaml
```yaml
# Copyright (c) 2026 The ZMK Contributors
# SPDX-License-Identifier: MIT

description: |
  Key toggle that only acts while a given layer is active. Two parameters: the key
  (param1) and the layer (param2). On press, if the layer is active, the key is toggled
  exactly as &kt would (see toggle-mode); if it is not active, nothing happens. The
  layer is checked at press time; the default layer always counts as active. Release
  does nothing. Fork patch, see PATCH_KEY_TOGGLE_IF_LAYER.md.

compatible: "zmk,behavior-key-toggle-if-layer"

include: two_param.yaml

properties:
  toggle-mode:
    type: string
    required: false
    default: "flip"
    enum:
      - "on"
      - "off"
      - "flip"
```

## app/dts/bindings/behaviors/zmk,behavior-magic-indicator-clear.yaml
```yaml
# Copyright (c) 2024, The ZMK Contributors
# SPDX-License-Identifier: MIT

description: |
  Clear ALL active relocatable BLE/USB indicators (both halves). No parameters.

compatible: "zmk,behavior-magic-indicator-clear"

include: zero_param.yaml
```

## app/dts/bindings/behaviors/zmk,behavior-magic-indicator-group.yaml
```yaml
# Copyright (c) 2024, The ZMK Contributors
# SPDX-License-Identifier: MIT

description: |
  Paint a fixed set of BLE/USB status indicators in a single behavior
  invocation (one queue entry instead of N chained &magic_indicator_on).
  `positions` = global pixel positions (same address space as &pixel).
  `selection` = matching WHICH values (MAGIC_BLE0..4 / MAGIC_USB).
  The two arrays must be the same length.

compatible: "zmk,behavior-magic-indicator-group"

include: zero_param.yaml

properties:
  positions:
    type: array
    required: true
    description: Global pixel positions for each indicator.
  selection:
    type: array
    required: true
    description: WHICH value per position (MAGIC_BLE0..4 or MAGIC_USB).
```

## app/dts/bindings/behaviors/zmk,behavior-magic-indicator-off.yaml
```yaml
# Copyright (c) 2024, The ZMK Contributors
# SPDX-License-Identifier: MIT

description: |
  Hide the relocatable BLE/USB indicator at a global pixel position.
  param1 = global strip position, param2 = WHICH (must match the matching _on).

compatible: "zmk,behavior-magic-indicator-off"

include: two_param.yaml
```

## app/dts/bindings/behaviors/zmk,behavior-magic-indicator-on.yaml
```yaml
# Copyright (c) 2024, The ZMK Contributors
# SPDX-License-Identifier: MIT

description: |
  Show a relocatable BLE/USB status indicator at a global pixel position.
  param1 = global strip position (same address space as &pixel: 0..local-1 =
  left/central, >= local = right/peripheral). param2 = WHICH (MAGIC_BLE0..4 or
  MAGIC_USB). Color is derived from live connection state using the native
  Magic-layer color ladder; it updates live while registered.

compatible: "zmk,behavior-magic-indicator-on"

include: two_param.yaml
```

## app/dts/bindings/behaviors/zmk,behavior-mirror-morph.yaml
```yaml
# Copyright (c) 2026 The ZMK Contributors
# SPDX-License-Identifier: MIT

description: |
  Mirror-morph (fork patch, PATCH_MIRROR_MODE.md §5). Like mod-morph, but picks its binding
  from the mirror instance that applies when the key is pressed (an instance applies while
  it is on and the highest active layer is in one of its groups):
    - without `instances`: bindings = <DEFAULT MIRRORED>; MIRRORED when any instance applies.
    - with `instances = <&a &b ...>`: bindings = <DEFAULT FOR_A FOR_B ...>, one more binding
      than instances; DEFAULT when none of the listed instances applies.
  The release always goes to the binding that was pressed. Used to give a mirror instance
  keys of its own, so instances can act as "virtual layers" on top of one real layer.

compatible: "zmk,behavior-mirror-morph"

include: zero_param.yaml

properties:
  bindings:
    type: phandle-array
    required: true
  instances:
    type: phandles
    description: Mirror instances (zmk,behavior-mirror), in the order of bindings[1..].
```

## app/dts/bindings/behaviors/zmk,behavior-mirror.yaml
```yaml
# Copyright (c) 2026 The ZMK Contributors
# SPDX-License-Identifier: MIT

description: |
  Mirror mode (fork patch, PATCH_MIRROR_MODE.md). While an instance is on, a key press on
  one of its layers acts as its mirror key, without any extra layer. The decision is made
  per key press from the highest active layer: if that layer is in one of the instance's
  child groups and the key isn't in that group's excluded-positions, the press is
  rewritten to mirror-positions[key] (combos match it as combo-positions[key]). Only one instance is on at a time; turning another on
  switches. The parameter is MIRROR_TOG / _ON / _OFF / _MO / _ONESHOT
  (dt-bindings/zmk/mirror.h).

compatible: "zmk,behavior-mirror"

include: one_param.yaml

properties:
  mirror-positions:
    type: array
    description: |
      One entry per key position (ZMK_KEYMAP_LEN entries): entry p is the key that
      pressing key p acts as. A key pointing at itself is not mirrored. Any relocation
      works, not only mirrors. Optional on GO60 (default MIRROR_MAP_GO60); required on any
      other board.
  combo-positions:
    type: array
    description: |
      Same form as mirror-positions, used only to match combos while this instance applies:
      a press of key p takes part in combos as key combo-positions[p]. Defaults to
      mirror-positions. Give the identity map (0 1 2 ...) to keep combos on their physical
      keys. excluded-positions apply to it too.
  overlay-id:
    type: int
    default: 0
    description: |
      Id sent to the host overlay in the 0xF4 Raw HID packet while this instance is on
      (1..255). 0 = not reported: the host sees "no mirror". Fixed per instance, so
      reordering nodes never changes it.
  enter:
    type: phandle-array
    specifier-space: binding
    description: Behaviors fired, in order, when this instance turns on.
  exit:
    type: phandle-array
    specifier-space: binding
    description: Behaviors fired, in order, when this instance turns off (also when switched away).
  not-press-release-outputs:
    type: boolean
    description: |
      Fire enter/exit as immediate side-effect outputs (press handler only, no queue, no
      release). Set it for &pixel / &pixlblink. Same meaning as in zmk-listeners.
  tap-ms:
    type: int
    default: 5
    description: Press-to-release time for enter/exit bindings on the queued path.
  wait-ms:
    type: int
    default: 5
    description: Time before the next enter/exit binding on the queued path.

child-binding:
  description: A group of layers that share the same excluded keys.
  properties:
    layers:
      type: array
      required: true
      description: Layers on which this instance mirrors (decided by the highest active layer).
    excluded-positions:
      type: array
      description: Keys never mirrored while one of this group's layers is on top.
```

## app/dts/bindings/behaviors/zmk,behavior-momentary-layer.yaml
```yaml
# Copyright (c) 2020 The ZMK Contributors
# SPDX-License-Identifier: MIT

description: Momentary layer on press/release behavior

compatible: "zmk,behavior-momentary-layer"

include: one_param.yaml

properties:
  locking:
    type: boolean
    description: |
      Fork, ported from upstream ZMK main (PATCH_LAYER_LOCKING.md). A layer turned on by a
      locking behavior is locked: behaviors without `locking` (stock &mo, &sl, conditional
      layers, modules) can't turn it off. A locking deactivation turns it off and unlocks it.
```

## app/dts/bindings/behaviors/zmk,behavior-pixel-color.yaml
```yaml
# Copyright (c) 2024, The ZMK Contributors
# SPDX-License-Identifier: MIT

description: |
  Persistently set an arbitrary LED (by strip position) to an arbitrary
  0xRRGGBB color, drawn on top of the underglow and surviving underglow
  on/off. param1 is the strip position, param2 is the color (negative clears).

compatible: "zmk,behavior-pixel-color"

include: two_param.yaml
```

## app/dts/bindings/behaviors/zmk,behavior-pixlblink-off.yaml
```yaml
# Copyright (c) 2024, The ZMK Contributors
# SPDX-License-Identifier: MIT

description: |
  Fixed companion to &pixlblink. Stops the blink at a single position (revealing
  whatever is beneath). Invoked with one parameter, the global strip position.
  Not user-configurable; the fork ships a single &pixlblink_off instance.

compatible: "zmk,behavior-pixlblink-off"

include: one_param.yaml
```

## app/dts/bindings/behaviors/zmk,behavior-pixlblink.yaml
```yaml
# Copyright (c) 2024, The ZMK Contributors
# SPDX-License-Identifier: MIT

description: |
  Sharp two-color blink of one LED (by strip position), on either half. This is a
  preset behavior: each named instance carries its own two colors and blink
  frequency, and is invoked with a single parameter (the global strip position).
  The LED hard-alternates color1 and color2 (color2 may be black for an off
  half-cycle) as a square wave. Stop a blink with the fixed &pixlblink_off
  behavior. Frequency encoding: freq_hz = frequency / 10 (so 5 = 0.5 Hz, 10 = 1 Hz).

compatible: "zmk,behavior-pixlblink"

include: one_param.yaml

properties:
  color1:
    type: int
    required: false
    default: 0xFFFFFF
    description: First (ON half-cycle) color, packed 0xRRGGBB.
  color2:
    type: int
    required: false
    default: 0x000000
    description: Second (OFF half-cycle) color, packed 0xRRGGBB. Black by default.
  frequency:
    type: int
    required: false
    default: 5
    description: Blink frequency code; freq_hz = frequency / 10 (5 = 0.5 Hz).
  blink-count:
    type: int
    required: false
    default: 0
    description: |
      Blink this many times, then stop by itself (1..255). A counted blink is timed from
      the moment it starts, so it always opens on color1; it shows color2 between blinks
      and ends after its last color1 half (2 * blink-count - 1 half-periods), revealing
      whatever is beneath, as &pixlblink_off would. 0 (the default) blinks until
      &pixlblink_off. Fork patch, see PATCH_PIXLBLINK.md.
```

## app/dts/bindings/behaviors/zmk,behavior-toggle-layer.yaml
```yaml
# Copyright (c) 2020 The ZMK Contributors
# SPDX-License-Identifier: MIT

description: Toggle Layer

compatible: "zmk,behavior-toggle-layer"

include: one_param.yaml

properties:
  toggle-mode:
    type: string
    required: false
    default: "flip"
    enum:
      - "on"
      - "off"
      - "flip"
  locking:
    type: boolean
    description: |
      Fork, ported from upstream ZMK main (PATCH_LAYER_LOCKING.md). A layer turned on by a
      locking behavior is locked: behaviors without `locking` (stock &mo, &sl, conditional
      layers, modules) can't turn it off. A locking deactivation turns it off and unlocks it.
```

## app/dts/bindings/behaviors/zmk,behavior-usb-indicator.yaml
```yaml
# Copyright (c) 2024, The ZMK Contributors
# SPDX-License-Identifier: MIT

description: |
  Persistent, relocatable USB output indicator. The `position` property is the
  physical strip pixel (local half) colored by USB connection state. Invoke with
  param1 = 1 to show, param1 = 0 to hide.

compatible: "zmk,behavior-usb-indicator"

include: one_param.yaml

properties:
  position:
    type: int
    required: true
    description: Physical strip pixel index (local half) for the USB indicator.
```
